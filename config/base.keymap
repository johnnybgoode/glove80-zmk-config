/*
 * Copyright (c) 2020 The ZMK Contributors
 * Copyright (c) 2025 Innaworks Development Limited, trading as MoErgo
 *
 * SPDX-License-Identifier: MIT
 */

#include <behaviors.dtsi>
/* Include all behavior includes needed */
#include <dt-bindings/zmk/outputs.h>
#include <dt-bindings/zmk/keys.h>
#include <dt-bindings/zmk/bt.h>
#include <dt-bindings/zmk/rgb.h>

#include <dt-bindings/zmk/pointing.h>
#include <input/processors.dtsi>
#include <dt-bindings/zmk/input_transform.h>
#include <zephyr/dt-bindings/input/input-event-codes.h>

#include <behaviors/num_word.dtsi>
#include <zmk-helpers/helper.h>

#include "os.h"

// Basis for HRM and thumb hold-tap timing
#define TAPPING_RESOLUTION 175

#define BASE   LAYER_ColemakDH
#define TYPG   LAYER_Typing
#define NAV    LAYER_Cursor
#define NUM    LAYER_Number
#define FUNC   LAYER_Function
#define SYM    LAYER_Symbol
#define MSE    LAYER_Mouse
#define MSEW   LAYER_MouseWarp
#define MSEF   LAYER_MouseFast
#define MSES   LAYER_MouseSlow
#define MSEI   LAYER_MouseFine
#define MAG    LAYER_Magic

#include "system.dtsi"
#include "macros.dtsi"
// #include "combos.dtsi"
// #include "mouse.dtsi"
#include "behaviors.dtsi"
#include "hrms.dtsi"
// #include "layers.dtsi"