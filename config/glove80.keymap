#include "glv80_keys.h"

/* Layers */
#define LAYER_Base 0
#define LAYER_ColemakDH 0
#define LAYER_Typing 1
#define LAYER_LeftPinky 2
#define LAYER_LeftRingy 3
#define LAYER_LeftMiddy 4
#define LAYER_LeftIndex 5
#define LAYER_RightPinky 6
#define LAYER_RightRingy 7
#define LAYER_RightMiddy 8
#define LAYER_RightIndex 9
#define LAYER_Cursor 10
#define LAYER_Number 11
#define LAYER_Function 12
#define LAYER_Symbol 13
#define LAYER_Mouse 14
#define LAYER_MouseFine 15
#define LAYER_MouseSlow 16
#define LAYER_MouseFast 17
#define LAYER_MouseWarp 18
#define LAYER_Magic 19
#define ALL_LAYERS 0 1 2 3 4 5 6 7 8 9 10 11 12 13 14 15 16 17 18 19

#include "base.keymap"

#include "combos.dtsi"
#include "mouse.dtsi"
// #include "behaviors.dtsi"

// Smart-mouse, requires tri-state module.
ZMK_TRI_STATE(smart_mse, bindings = <&tog MSE>, <&none>, <&tog MSE>;
    ignored-key-positions = 
      <LU2 LU1 RU1 RU2 RU3 LH4 LH2 LH1 RH0 RH1 RH2 RH3 RH4 RH5 RL0 RL5 LB4 LB3 LB2 LB1 LT5 LT6 RT5>;
    ignored-layers = < BASE MSE MSEW MSEI MSES MSEF >;
)

// #include "hrms.dtsi"
#include "glv80_layers.dtsi"

GLV80_LAYER(ColemakDH,
   &kp GRAVE      &kp Q      &kp W      &kp F           &kp P  &kp B,                                                                                      &kp J      &kp L        &kp U        &kp Y   &kp SEMI   &kp MINUS,
  &sft_capsw  &hrml_p A  &hrml_r R  &hrml_m S       &hrml_i T  &kp G,                                                                                      &kp M  &hrmr_i N    &hrmr_m E    &hrmr_r I  &hrmr_p O     &kp SQT,
       &none      &kp Z      &kp X      &kp C           &kp D  &kp V,  &thm FUNC ESC      &lpar_lt   &lpar_gt,   &kp _HOME      &kp _END  &thm MAG ENTER,  &kp K      &kp H  &semi_comma      &kp DOT   &kp FSLH  &sft_capsw,
  &mag MAG 0  &kp EQUAL   &kp LBKT   &kp RBKT  &thm MSE BSLH,          &thm NAV BSPC  &thm NUM DEL  &tog TYPG,  &smart_mse  &thm MSE TAB  &spc SYM SPACE,         &kp PG_DN  &msc MSC_DN  &msc MSC_UP  &kp PG_UP   &mag MAG 0
)

GLV80_LAYER(Typing,
  &trans     &trans     &trans     &trans      &trans  &trans,                                                       &trans     &trans     &trans     &trans     &trans  &trans,
  &trans      &kp A      &kp R      &kp S       &kp T  &trans,                                                       &trans      &kp N      &kp E      &kp I      &kp O  &trans,
  &trans     &trans     &trans     &trans      &trans  &trans,  &trans  &trans  &trans,     &trans  &trans  &trans,  &trans     &trans     &trans     &trans     &trans  &trans,
  &trans  &kp HRM_P  &kp HRM_R  &kp HRM_M  &kp HRM_I,           &trans  &trans  &trans,  &tog TYPG  &trans  &trans,          &kp HRM_I  &kp HRM_M  &kp HRM_R  &kp HRM_P   &trans
)

#include "glv80_hrm_bilateral_layers.dtsi"

GLV80_LAYER(Cursor,
      &none      &kp RET     &kp SPACE         &kp TAB         &kp BSPC    &kp _CUT,                                                                        &kp _CUT  &kp LS(TAB)       &kp _UNDO       &kp _REDO    &kp TAB      &none,
  &sk LSHFT    &kp HRM_P     &kp HRM_R       &kp HRM_M        &kp HRM_I   &kp _COPY,                                                                       &kp _COPY     &kp LEFT        &kp DOWN          &kp UP  &kp RIGHT  &sk LSHFT,
  &kp _C(L)  &select_all  &select_line    &select_word        &kp _FIND  &kp _PASTE,   &kp ESC  &none  &none,  &select_none  &extend_line  &extend_word,  &kp _PASTE    &kp _HOME       &kp PG_DN       &kp PG_UP   &kp _END  &kp _C(L),
  &kp _C(K)    &kp _UNDO     &kp _REDO  &kp _FIND_PREV  &kp _FIND_NEXT,               &tog NAV  &none  &none,   &select_all  &select_line  &select_word,                &kp _FIND  &kp _FIND_PREV  &kp _FIND_NEXT  &kp _C(H)   &kp _C(K)
)

GLV80_LAYER(Number,
          &kp E      &kp RET     &kp SPACE         &kp TAB         &kp BSPC  &kp N0,                                                                     &kp LS(G)      &kp N7    &kp N8    &kp N9  &kp LS(SEMI)     &kp LS(N5),
      &sk LSHFT    &kp HRM_P     &kp HRM_R       &kp HRM_M        &kp HRM_I   &kp X,                                                                         &kp K      &kp N4    &kp N5    &kp N6     &kp MINUS  &kp LS(EQUAL),
  &kp LS(MINUS)  &select_all  &select_line    &select_word        &kp _FIND   &kp F,  &kp ESC     &none  &none,  &kp LS(COMMA)  &kp LS(DOT)  &kp COMMA,      &kp J      &kp N1    &kp N2    &kp N3      &kp FSLH     &kp LS(N8),
          &none    &kp _UNDO     &kp _REDO  &kp _FIND_PREV  &kp _FIND_NEXT,             &none  &tog NUM  &none,      &kp EQUAL      &kp DOT     &kp N0,             &kp LS(N9)  &kp LBKT  &kp RBKT    &kp LS(N0)      &kp LS(N2)
)

GLV80_LAYER(Function,
      &none      &kp RET     &kp SPACE         &kp TAB         &kp BSPC  &kp K_CALC,                                                                        &kp K_CALC         &kp F7      &kp F8      &kp F9   &kp F10        &kp F13,
  &sk LSHFT    &kp HRM_P     &kp HRM_R       &kp HRM_M        &kp HRM_I   &kp K_WWW,                                                                         &kp K_WWW         &kp F4      &kp F5      &kp F6   &kp F11        &kp F14,
      &none  &select_all  &select_line    &select_word        &kp _FIND  &kp _FILES,  &tog FUNC  &none  &none,  &kp C_BRI_MIN  &kp C_BRI_DN  &kp C_BRI_UP,  &kp _FILES         &kp F1      &kp F2      &kp F3   &kp F12        &kp F15,
      &none    &kp _UNDO     &kp _REDO  &kp _FIND_PREV  &kp _FIND_NEXT,                   &none  &none  &none,     &kp C_MUTE  &kp C_VOL_DN  &kp C_VOL_UP,              &kp C_BRI_MAX  &kp C_PREV  &kp C_NEXT  &kp C_PP  &kp C_BRI_AUTO
)

GLV80_LAYER(Symbol,
      &kp GRAVE      &kp COMMA    &kp LS(N9)            &kp LS(N0)        &kp SEMI       &kp DOT,                                                                                 &none      &none        &none      &none      &none  &none,
     &kp LS(N1)       &kp LBKT  &kp LS(LBKT)          &kp LS(RBKT)        &kp RBKT  &kp LS(FSLH),                                                                             &kp GRAVE    &kp DEL  &kp LS(TAB)    &kp INS    &kp ESC  &none,
     &kp LS(N3)     &kp LS(N6)     &kp EQUAL             &kp MINUS      &kp LS(N4)    &kp LS(N8),                                                                  &kp LS(SINGLE_QUOTE)   &kp BSPC      &kp TAB  &kp SPACE    &kp RET  &none,
  &kp LS(GRAVE)  &kp LS(COMMA)  &kp LS(BSLH)         &kp LS(MINUS)     &kp LS(DOT)      &kp FSLH,    &kp BSLH       &kp DOT  &kp LS(N8),  &none  &none     &none,               &kp SQT  &sk HRM_I    &sk HRM_M  &sk HRM_R  &sk HRM_P  &none,
       &dot_dot     &kp LS(N7)       &kp SQT  &kp LS(SINGLE_QUOTE)  &kp LS(EQUAL),                 &kp LS(N5)  &kp LS(SEMI)  &kp LS(N2),  &none  &none  &tog SYM,                            &none        &none      &none      &none   &none
)

GLV80_LAYER(Mouse,
  &none     &mkp MB5  &mkp RCLK  &mkp MCLK   &mkp LCLK     &mkp MB4,                                                                         &mkp MB4       &mkp LCLK       &mkp RCLK     &mkp MCLK         &mkp MB5        &none,
  &none    &kp HRM_P  &kp HRM_R  &kp HRM_M   &kp HRM_I  &msc MSC_UP,                                                                       &msc MSC_L  &mmv MOVE_LEFT  &mmv MOVE_DOWN  &mmv MOVE_UP  &mmv MOVE_RIGHT   &msc MSC_R,
  &none  &msc MSC_DN   &kp _CUT  &kp _COPY  &kp _PASTE  &msc MSC_DN,  &kp _PASTE  &kp _COPY  &kp _CUT  &kp _CUT,  &kp _COPY  &kp _PASTE,  &msc MSC_DN       &sk HRM_I       &sk HRM_M     &sk HRM_R        &sk HRM_P  &msc MSC_UP,
  &none     &mo MSEW   &mo MSEI   &mo MSES   &mo MSEF,                 &mkp LCLK  &mkp RCLK  &mkp MB4     &none,   &tog MSE       &none,                     &mo MSEF        &mo MSES      &mo MSEI         &mo MSEW     &kp K_APP
)

#include "glv80_mouse_warp_layers.dtsi"

GLV80_LAYER(Magic,
 &bt BT_CLR            &none            &none            &none           &none,                                                                                            &none  &none  &none  &none  &bt BT_CLR_ALL,
      &to 0            &to 1            &to 2            &to 3            &to 4            &to 5,                                                                   &none  &none  &none  &none  &none           &none,
      &none  &rgb_ug RGB_SPI  &rgb_ug RGB_SAI  &rgb_ug RGB_HUI  &rgb_ug RGB_BRI  &rgb_ug RGB_TOG,                                                                   &none  &none  &none  &none  &none           &none,
&bootloader  &rgb_ug RGB_SPD  &rgb_ug RGB_SAD  &rgb_ug RGB_HUD  &rgb_ug RGB_BRD  &rgb_ug RGB_EFF,                                                                   &none  &none  &none  &none  &none     &bootloader,
 &sys_reset            &none            &none            &none            &none            &none,  &bt_2  &bt_3         &none,  &kp _POWER  &kp _SLEEP  &kp _LOCK,  &none  &none  &none  &none  &none      &sys_reset,
      &none            &none            &none            &none           &none,                    &bt_0  &bt_1  &out OUT_USB,       &none       &none      &none,         &none  &none  &none  &none            &none
)
