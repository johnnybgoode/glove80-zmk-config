## config/west.yml
```yaml
---
manifest:
  defaults:
    remote: urob
    revision: v0.3

  remotes:
    - name: moergo
      url-base: https://github.com/moergo-sc
    - name: urob
      url-base: https://github.com/urob
    - name: zmkfirmware
      url-base: https://github.com/zmkfirmware

  projects:
    - name: zmk
      remote: moergo
      revision: main
      import: app/west.yml

    # ZMK modules
    - name: zmk-adaptive-key
      path: modules/zmk/adaptive-key
    - name: zmk-auto-layer
      path: modules/zmk/auto-layer
    - name: zmk-helpers
      path: modules/zmk/helpers
    - name: zmk-leader-key
      path: modules/zmk/leader-key
    - name: zmk-tri-state
      path: modules/zmk/tri-state
    - name: zmk-unicode
      path: modules/zmk/unicode

    # Only source necessary Zephyr modules. Remove this entire section to restore
    # the default (needed for less common hardware).
    - name: zephyr
      remote: zmkfirmware
      revision: v3.5.0+zmk-fixes
      clone-depth: 1
      import:
        name-allowlist:
          - cmsis
          - hal_nordic
          - hal_rpi_pico
          - hal_stm32
          - lvgl
          - tinycrypt

  self:
    path: config
```
