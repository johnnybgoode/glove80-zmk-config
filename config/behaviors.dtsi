#define THUMB_HOLDING_TIME 150
#define THUMB_REPEAT_DECAY 350

#define THUMB_HOLD_TAP(NAME, BINDING1 , BINDING2)                                 \
  ZMK_HOLD_TAP(NAME, bindings = <BINDING1>, <BINDING2>; flavor = "balanced";      \
    tapping-term-ms = <THUMB_HOLDING_TIME>; quick-tap-ms = <THUMB_REPEAT_DECAY>;)

#define TD_TERM_FAST 180
#define TD_TERM_NORM 200
#define TD_TERM_SLOW 300
#define TAP_DANCE_FAST(NAME, BINDING1, BINDING2)                                  \
  ZMK_TAP_DANCE(NAME, bindings = <BINDING1>, <BINDING2>;                          \
    tapping-term-ms = <TD_TERM_FAST>;)
#define TAP_DANCE_NORM(NAME, BINDING1, BINDING2)                                  \
  ZMK_TAP_DANCE(NAME, bindings = <BINDING1>, <BINDING2>;                          \
    tapping-term-ms = <TD_TERM_NORM>;)

#define TAP_DANCE_SLOW(NAME, BINDING1, BINDING2)                                  \
  ZMK_TAP_DANCE(NAME, bindings = <BINDING1>, <BINDING2>;                          \
    tapping-term-ms = <TD_TERM_SLOW>;)

#define SIMPLE_MORPH(NAME, MOD, BINDING1, BINDING2)                               \
  ZMK_MOD_MORPH(NAME, mods = <(MOD_L##MOD | MOD_R##MOD)>;                         \
                bindings = <BINDING1>, <BINDING2>;)

THUMB_HOLD_TAP(thm, &mo, &kp)

// Tap: BACKSPACE | double-tap: nav_word | Hold: nav(cursor)-layer.
//#define SMART_NAV &smart_nav CURS 0
//ZMK_AUTO_LAYER(nav_word,
//  continue-list = <LEFT DOWN UP RIGHT CUT _COPY _PASTE LSFT RSFT \
//  _HOME PG_DN PG_UP _END>;)
//THUMB_HOLD_TAP(smart_nav, &mo, &nav_dance)
//ZMK_TAP_DANCE(nav_dance,
//  bindings = <&kp BSPC>, <&nav_word CURS>, <&kp BSPC>;
//  tapping-term-ms = <TD_TERM_FAST>;)

// Tap: DELETE | double-tap: num_word | Hold: num-layer.
//#define SMART_NUM &smart_num NUM 0
//THUMB_HOLD_TAP(smart_num, &mo, &num_dance)
//ZMK_TAP_DANCE(num_dance,
//  bindings = <&kp DELETE>, <&num_word NUM>, <&kp DELETE>;
//  tapping-term-ms = <TD_TERM_NORM>;)

// Smart-mouse, requires tri-state module.
ZMK_TRI_STATE(smart_mse, bindings = <&tog MSE>, <&none>, <&tog MSE>;
    ignored-key-positions = 
      <LU2 LU1 RU1 RU2 RU3 LH4 LH2 LH1 RH0 RH1 RH2 RH3 RH4 RH5 RL0 RL5 LB4 LB3 LB2 LB1 LT5 LT6 RT5>;
    ignored-layers = < BASE MSE MSEW MSEI MSES MSEF >;
)

#define SPACE_HOLDING_TIME 200
#define SPACE_REPEAT_DECAY SPACE_HOLDING_TIME
ZMK_HOLD_TAP(spc,
    bindings = <&mo>, <&kp>; flavor = "balanced";
    tapping-term-ms = <SPACE_HOLDING_TIME>; quick-tap-ms = <SPACE_REPEAT_DECAY>;
)

SIMPLE_MORPH(lpar_lt, SFT, &kp LPAR, &kp LT)
SIMPLE_MORPH(lpar_gt, SFT, &kp RPAR, &kp GT)

TAP_DANCE_SLOW(sft_capsw,  &sk_oneshot LSFT, &caps_word)
TAP_DANCE_NORM(semi_comma, &kp COMMA, &kp SEMI)

TAP_DANCE_NORM(vimQuit, &kp Q, &q_bang)

#define STICKY_HOLDING_TIME (TAPPING_RESOLUTION + 25)
#define STICKY_1SHOT_DECAY 500
ZMK_MACRO_ONE_PARAM(sk_oneshot,
  wait-ms = <0>;
  tap-ms = <0>;
  bindings
  = <&macro_param_1to1>
  , <&macro_tap &sk_qr MACRO_PLACEHOLDER>
  ;
)
ZMK_HOLD_TAP(sk_modtap,
  bindings = <&kp>, <&sk_oneshot>; flavor = "tap-preferred";
  tapping-term-ms = <STICKY_HOLDING_TIME>;
)
ZMK_STICKY_KEY(sk_qr,
  bindings = <&kp>;
  release-after-ms = <STICKY_1SHOT_DECAY>; quick-release; ignore-modifiers;
)

/ {
  behaviors {
    caps_word {
      continue-list = <
        UNDERSCORE MINUS
        BACKSPACE DELETE
        N1 N2 N3 N4 N5 N6 N7 N8 N9 N0
      >;
    };
  };
};
